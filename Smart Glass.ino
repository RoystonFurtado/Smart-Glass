#include <Wire.h>
#include <Adafruit_GFX.h>
#include <Adafruit_SSD1306.h>
#include <SoftwareSerial.h>

#define OLED_ADDR   0x3C
SoftwareSerial mySerial(6, 5);//RX,TX
Adafruit_SSD1306 display(-1);

#if (SSD1306_LCDHEIGHT != 64)
#error("Height incorrect, please fix Adafruit_SSD1306.h!");
#endif

void setup()   {                
  
  display.begin(SSD1306_SWITCHCAPVCC,OLED_ADDR);//if it doesnt work try display.begin(SSD1306_SWITCHCAPVCC, OLED_ADDR,false)
  display.clearDisplay();
  display.display();
  Serial.begin(9600);
  mySerial.begin(9600);

  display.setTextSize(2);
  display.setTextColor(WHITE);
  display.setCursor(0,0);
  drawBitMap(0,0);
  display.display();
  delay(2000);
  display.clearDisplay();
  display.clearDisplay();
}

void loop() {

  
  display.setTextSize(2);
  display.setTextColor(WHITE);
  display.setCursor(5,17);


while(mySerial.available()){

  
  
  String hh = mySerial.readStringUntil(':');

  
  String mm =  mySerial.readStringUntil(':');

  String ss =  mySerial.readStringUntil(':');

  String spm = mySerial.readStringUntil('/');

  String call = mySerial.readStringUntil(':');

  String iName = mySerial.readStringUntil(':');

  String iNum = mySerial.readStringUntil('/');

  String msg = mySerial.readStringUntil(':');

  String mName = mySerial.readStringUntil(':');

  String mBody = mySerial.readStringUntil('/');

  String battery = mySerial.readStringUntil('/');
  

//Serial.println(iNum);
display.setTextSize(1);
display.setCursor(50,0);
display.print("      ");
display.print(battery);
display.print("%");
display.setCursor(5,17);
display.setTextSize(2);
if(call=="1")
{
  //Serial.print("Ringing");
  if(iName=="Unknown")
  {
  display.setTextSize(1);
  display.print("   ");
  display.print(iNum);
  display.setTextSize(2);
  display.print("\n  Calling");
  }
  else
  {
  display.print("  "+iName);
  display.print("\n  Calling");
  }
  display.display();
  display.clearDisplay();

}
else if(msg=="1")
{
  display.setCursor(0,0);
  display.print("Message\nfrom\n ");
  display.print(mName);
  display.display();
  delay(4000);
  display.clearDisplay();
  display.setCursor(5,17);
  display.setTextSize(1);
  display.print(mBody);
  display.display();
  delay(6000);
  display.clearDisplay();
}
else
{
if(hh.length()==1)
{
  display.print("0");
  display.print(hh);
}
else
display.print(hh);
display.print(":");
if(mm.length()==1)
{
  display.print("0");
  display.print(mm);
}
else
{
display.print(mm);
}
display.print(":");
if(ss.length()==1)
{
  display.print("0");
  display.print(ss);
}
else
{
  display.print(ss);
}
int sspm=spm.toInt();
if(sspm==1)
{
display.print("PM");  
}
else
{
display.print("AM");
}

display.display();
display.clearDisplay();

}

}


}
const unsigned char PROGMEM fly [] = {
  // size is 56 x 64 
0xff, 0xff, 0xff, 0xff, 0xff, 0xff, 0xff, 0xff, 0xff, 0xff, 0xff, 0xff, 0xff, 0xff, 0xff, 0xff,
0xff, 0xff, 0xff, 0xff, 0xff, 0xff, 0xff, 0xff, 0xff, 0xff, 0xff, 0xff, 0xff, 0xff, 0xff, 0xff,
0xff, 0xff, 0xff, 0xff, 0xff, 0xff, 0xff, 0xff, 0xff, 0xff, 0xff, 0xff, 0xff, 0xff, 0xff, 0xff,
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0xff, 0xff, 0xff, 0xff, 0xff, 0xff, 0xff, 0xff, 0xff, 0xff, 0xff, 0xff, 0xff, 0xff, 0xff, 0xff,
};
void drawBitMap(int x, int y)
{
  display.drawBitmap(x, y,  fly, 128, 64, 1);
  
}
